&spi3 {
    compatible = "nordic,nrf-spim";
    status = "okay";
    cs-gpios = <&gpio0 7 GPIO_ACTIVE_LOW>; // Pin para CS
    label = "SPI_3";
};

&gpio0 {
    status = "okay";
    label = "GPIO_0";
};