&spi3 {
	compatible = "nordic,nrf-spis";
	def-char = <0x5A>;
    status = "okay";
    cs-gpios = <&gpio0 7 GPIO_ACTIVE_LOW>; // Pin para CS
    label = "SPI_3";
};

&gpio0 {
    status = "okay";
    label = "GPIO_0";
};