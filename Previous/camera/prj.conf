## prj.conf
```kconfig
# Habilitar el controlador SPI
CONFIG_SPI=y

# Habilitar el controlador GPIO
CONFIG_GPIO=y

# Habilitar los logs del sistema para depuración
CONFIG_LOG=y
CONFIG_LOG_DEFAULT_LEVEL=3

CONFIG_DK_LIBRARY=y
CONFIG_LOG_MODE_IMMEDIATE=y
CONFIG_LOG_PRINTK=n
CONFIG_MODEM_ANTENNA_AT_MAGPIO=""
CONFIG_MODEM_ANTENNA_AT_COEX0=""
CONFIG_NRF_MODEM_LOG=n
CONFIG_NRF_MODEM_LIB_LOG_LEVEL_DBG=n
```

## src/debug.cpp
```c
/*
 * This program is free software: you can redistribute it and/or modify
 * it under the terms of the GNU General Public License as published by
 * the Free Software Foundation, either version 3 of the License, or
 * (at your option) any later version.
 *
 * This program is distributed in the hope that it will be useful,
 * but WITHOUT ANY WARRANTY; without even the implied warranty of
 * MERCHANTABILITY or FITNESS FOR A PARTICULAR PURPOSE.  See the
 * GNU General Public License for more details.
 *
 * You should have received a copy of the GNU General Public License
 * along with this program.  If not, see <http://www.gnu.org/licenses/>.
 *
 * Author: Maxim Penner <maxim.penner@ikt.uni-hannover.de>
 */

#include <string>
#include <bitset>
#include <algorithm>
#include <include/utils/debug.h>

static void write_bits_of_byte_one_per_line(std::ofstream &f, std::string s){
    for(uint32_t j=0; j<8; j++){
        f << s[j] << std::endl;
    }
}

namespace dect2020 {

void file_binary_representation_msb_first(const char* filename, const uint8_t* in, uint32_t len_bytes){

    std::ofstream f(filename, std::ios::trunc);
    for(uint32_t i=0; i<len_bytes; i++){
        std::bitset<8> b(in[i]);
        std::string s = b.to_string();
        write_bits_of_byte_one_per_line(f, s);
    }
    f.close();
}

void file_binary_representation_lsb_first(const char* filename, const uint8_t* in, uint32_t len_bytes){
    std::ofstream f(filename, std::ios::trunc);
    for(uint32_t i=0; i<len_bytes; i++){
        std::bitset<8> b(in[i]);
        std::string s = b.to_string();
        std::reverse(s.begin(), s.end());
        write_bits_of_byte_one_per_line(f, s);
    }
    f.close();
}

}
```

## src/debug.h
```c
/*
 * This program is free software: you can redistribute it and/or modify
 * it under the terms of the GNU General Public License as published by
 * the Free Software Foundation, either version 3 of the License, or
 * (at your option) any later version.
 *
 * This program is distributed in the hope that it will be useful,
 * but WITHOUT ANY WARRANTY; without even the implied warranty of
 * MERCHANTABILITY or FITNESS FOR A PARTICULAR PURPOSE.  See the
 * GNU General Public License for more details.
 *
 * You should have received a copy of the GNU General Public License
 * along with this program.  If not, see <http://www.gnu.org/licenses/>.
 *
 * Author: Maxim Penner <maxim.penner@ikt.uni-hannover.de>
 */

#ifndef DECT2020_DEBUG_H
#define DECT2020_DEBUG_H

#include <stdint.h>
// #include <fstream>

//extern "C"{
//#include <debug.h>
//}

#define DECT2020_SUCCESS    0
#define DECT2020_ERROR      -1



// void file_binary_representation_msb_first(const char* filename, const uint8_t* in, uint32_t len_bytes);
// void file_binary_representation_lsb_first(const char* filename, const uint8_t* in, uint32_t len_bytes);

// template<typename T>
// void file_binary_representation_unpacked(const char* filename, const T* in, uint32_t len, bool convert_to_1_0){
//     std::ofstream f(filename, std::ios::trunc);
//     for(uint32_t i=0; i<len; i++){
//         if(convert_to_1_0){
//             if(in[i] > 0)
//                 f << (int) 1 << std::endl;
//             else
//                 f << (int) 0 << std::endl;
//         }
//         else{
//             f << (int) in[i] << std::endl;
//         }
//     }
//     f.close();
// }


#endif
```

## src/mac_message.h
```c
/*
	Author: Iván Tomás García
	Property of the Universidad Politécnica de Cartagena
*/

#include <stdint.h>
#ifndef MAC_MESSAGE_H
#define MAC_MESSAGE_H

	typedef struct {

		//Network Beacon Message(6.4.2.2)
		uint8_t	Reserved					: 3;
		uint8_t	TX_Power					: 1;
		uint8_t	Power_Const					: 1;
		uint8_t	Current						: 1;
		uint8_t	Network_Beacon_Channels		: 2;
		uint8_t	Network_Beacon_Period		: 4;
		uint8_t	Cluster_Beacon_Period		: 4;
		uint8_t	Reserved_1					: 3;
		uint16_t	Next_Cluster_Channel	: 13;
		uint32_t	TTn						: 32;	//Time To next
		uint8_t	Reserved_2					: 4;
		uint8_t	Clusters_Max_TX_Power		: 4;
		uint8_t	Reserved_3					: 3;
		uint16_t	Current_Cluster_Channel	: 13;
		uint8_t	Reserved_4					: 3;
		uint16_t	ANBC					: 13;	//Additional_Network_Beacon_Channels
		
		uint8_t	mlmf_1[13];
	}mlmf_1_t;

	typedef struct {

		//Cluster Beacon Message(6.4.2.3)
		uint8_t	SFN							: 8;
		uint8_t	Reserved					: 3;
		uint8_t	TX_Power					: 1;
		uint8_t	Power_Const					: 1;
		uint8_t	FO							: 1;
		uint8_t Next_Channel				: 1;
		uint8_t	TTN							: 1;
		uint8_t	Network_Beacon_Period		: 4;
		uint8_t	Cluster_Beacon_Period		: 4;
		uint8_t	countToTrigger				: 4;
		uint8_t	ReQuality					: 2;
		uint8_t	MinQuality					: 2;
		uint8_t	Reserved_1					: 4;
		uint8_t	Clusters_Max_TX_Power		: 4;
		uint8_t	Frame_Offset				: 8;
		uint8_t	Reserved_2					: 3;
		uint16_t	Next_Cluster_Channel	: 13;
		uint32_t	TTn						: 32;	//Time To next
		
		uint8_t	mlmf_2[12];
	}mlmf_2_t;

	typedef struct {

		//Association Request Message(6.4.2.4)
		uint8_t	Setup_Cause					: 3;
		uint8_t	N_Flows						: 3;
		uint8_t	Power_Const					: 1;
		uint8_t	FT_Mode						: 1;
		uint8_t Current						: 1;
		uint8_t	Reserved					: 7;
		uint8_t	HARQ_P_TX					: 3;
		uint8_t	MAX_HARQ_Re_TX				: 5;
		uint8_t	HARQ_P_RX					: 3;
		uint8_t	MAX_HARQ_Re_RX				: 5;
		uint8_t	Reserved_1					: 2;
		uint8_t	FlowID						: 6;
		uint8_t	Network_Beacon_Period		: 4;
		uint8_t	Cluster_Beacon_Period		: 4;
		uint8_t	Reserved_2					: 3;
		uint16_t	Next_Cluster_Channel	: 13;
		uint32_t	TTn						: 32;	//Time To next
		uint8_t	Reserved_3					: 3;
		uint16_t	Current_Cluster_Channel	: 13;

		uint8_t	mlmf_3[14];
	}mlmf_3_t;

	typedef struct {

		//Association Response Message(6.4.2.5)
		uint8_t	ACK_NACK		: 1;
		uint8_t	Reserved		: 1;
		uint8_t	HARQ_mod		: 1;
		uint8_t	NFlows			: 3;
		uint8_t Group			: 1;
		uint8_t	TX_Power		: 1;
		uint8_t	Reject_Cause	: 4;
		uint8_t	Reject_Time		: 4;
		uint8_t	HARQ_P_RX		: 3;
		uint8_t	MAX_HARQ_Re_RX	: 5;
		uint8_t	HARQ_P_TX		: 3;
		uint8_t	MAX_HARQ_Re_TX	: 5;
		uint8_t	Reserved_1		: 2;
		uint8_t	Flow_ID			: 6;
		uint8_t	Reserved_2		: 1;
		uint8_t	Group_ID		: 7;
		uint8_t	Reserved_3		: 1;	//Time To next
		uint8_t	Resource_TAG	: 7;

		uint8_t	mlmf_4[7];
	}mlmf_4_t;


	typedef struct {

		//Association Request Message(6.4.2.6)
		uint8_t	Release_Cause	: 4;
		uint8_t	Reserved		: 4;

		uint8_t	mlmf_5;
	}mlmf_5_t;


	typedef struct {

		//Reconfiguration Request Message(6.4.2.7)
		uint8_t	TX_HARQ			: 1;
		uint8_t	RX_HARQ			: 1;
		uint8_t	RD_Capability	: 1;
		uint8_t	N_Flows			: 3;
		uint8_t Radio_Resource	: 2;
		uint8_t HARQ_P_TX		: 3;
		uint8_t	MAX_HARQ_Re_TX	: 5;
		uint8_t	HARQ_P_RX		: 3;
		uint8_t	MAX_HARQ_Re_RX	: 5;
		uint8_t	Setup_Release	: 1;
		uint8_t	Reserved		: 1;
		uint8_t	Flow_ID			: 6;

		uint8_t	mlmf_6[4];
	}mlmf_6_t;


	typedef struct {

		//Reconfiguration Response Message(6.4.2.8)
		uint8_t	TX_HARQ			: 1;
		uint8_t	RX_HARQ			: 1;
		uint8_t	RD_Capability	: 1;
		uint8_t	N_Flows			: 3;
		uint8_t Radio_Resource	: 2;
		uint8_t HARQ_P_TX		: 3;
		uint8_t	MAX_HARQ_Re_TX	: 5;
		uint8_t	HARQ_P_RX		: 3;
		uint8_t	MAX_HARQ_Re_RX	: 5;
		uint8_t	Setup_Release	: 1;
		uint8_t	Reserved		: 1;
		uint8_t	Flow_ID			: 6;

		uint8_t	mlmf_7[4];
	}mlmf_7_t;


	typedef struct {

		//Additional MAC message (6.4.2.9)
	
	}mlmf_8_t;

	int get_mlmf_1(mlmf_1_t* mlmf_1);
	int get_mlmf_2(mlmf_2_t* mlmf_2);
	int get_mlmf_3(mlmf_3_t* mlmf_3);
	int get_mlmf_4(mlmf_4_t* mlmf_4);
	int get_mlmf_5(mlmf_5_t* mlmf_5);
	int get_mlmf_6(mlmf_6_t* mlmf_6);
	int get_mlmf_7(mlmf_7_t* mlmf_7);

	int get_mlmf_1_rev(mlmf_1_t* mlmf_1);
	int get_mlmf_2_rev(mlmf_2_t* mlmf_2);
	int get_mlmf_3_rev(mlmf_3_t* mlmf_3);
	int get_mlmf_4_rev(mlmf_4_t* mlmf_4);
	int get_mlmf_5_rev(mlmf_5_t* mlmf_5);
	int get_mlmf_6_rev(mlmf_6_t* mlmf_6);
	int get_mlmf_7_rev(mlmf_7_t* mlmf_7);



#endif 
```

## src/math_functions.h
```c
/*
 * This program is free software: you can redistribute it and/or modify
 * it under the terms of the GNU General Public License as published by
 * the Free Software Foundation, either version 3 of the License, or
 * (at your option) any later version.
 *
 * This program is distributed in the hope that it will be useful,
 * but WITHOUT ANY WARRANTY; without even the implied warranty of
 * MERCHANTABILITY or FITNESS FOR A PARTICULAR PURPOSE.  See the
 * GNU General Public License for more details.
 *
 * You should have received a copy of the GNU General Public License
 * along with this program.  If not, see <http://www.gnu.org/licenses/>.
 *
 * Author: Maxim Penner <maxim.penner@ikt.uni-hannover.de>
 */

#ifndef DECT2020_MATH_FUNCTIONS_H
#define DECT2020_MATH_FUNCTIONS_H

#include <cstdint>

namespace dect2020 {

template<typename T>
T ceil_divide_integer(T x, T y){
    return (x + y - 1) / y;
}

}

#endif
```

## src/physical_header_field.c
```c
/*
 * This program is free software: you can redistribute it and/or modify
 * it under the terms of the GNU General Public License as published by
 * the Free Software Foundation, either version 3 of the License, or
 * (at your option) any later version.
 *
 * This program is distributed in the hope that it will be useful,
 * but WITHOUT ANY WARRANTY; without even the implied warranty of
 * MERCHANTABILITY or FITNESS FOR A PARTICULAR PURPOSE.  See the
 * GNU General Public License for more details.
 *
 * You should have received a copy of the GNU General Public License
 * along with this program.  If not, see <http://www.gnu.org/licenses/>.
 *
 * Author: Maxim Penner <maxim.penner@ikt.uni-hannover.de>
 */
#include <string.h>
#include "physical_header_field.h"
#include "debug.h"


int get_plcf_1(plcf_10_t* plcf_10){                                                       //Physical Layer Control Field Type 1 (6.2.1-1)

    plcf_10->plcf[0] = (plcf_10->plcf[0] & 0x1F) | (plcf_10->HeaderFormat << 5);
    plcf_10->plcf[0] = (plcf_10->plcf[0] & 0xEF) | (plcf_10->PacketLengthType << 4);
    plcf_10->plcf[0] = (plcf_10->plcf[0] & 0xF0) | plcf_10->PacketLength;

    plcf_10->plcf[1] = plcf_10->ShortNetworkID;

    plcf_10->plcf[2] = (uint8_t) (plcf_10->TransmitterIdentity >> 8);
    plcf_10->plcf[3] = (uint8_t) (plcf_10->TransmitterIdentity & 0xFF);

    plcf_10->plcf[4] = (plcf_10->plcf[4] & 0xF) | (plcf_10->TransmitPower << 4);
    plcf_10->plcf[4] = (plcf_10->plcf[4] & 0xF7) | (plcf_10->Reserved << 3);
    plcf_10->plcf[4] = (plcf_10->plcf[4] & 0xF8) | plcf_10->DFMCS;

    return DECT2020_SUCCESS;
}

int get_plcf_2(plcf_20_t* plcf_20){                                                       //Physical Layer Control Field Type 2 Header Format 000 (6.2.1-2)

    plcf_20->plcf[0] = (plcf_20->plcf[0] & 0x1F) | (plcf_20->HeaderFormat << 5);
    plcf_20->plcf[0] = (plcf_20->plcf[0] & 0xEF) | (plcf_20->PacketLengthType << 4);
    plcf_20->plcf[0] = (plcf_20->plcf[0] & 0xF0) | plcf_20->PacketLength;

    plcf_20->plcf[1] = plcf_20->ShortNetworkID;

    plcf_20->plcf[2] = (uint8_t) (plcf_20->TransmitterIdentity >> 8);
    plcf_20->plcf[3] = (uint8_t) (plcf_20->TransmitterIdentity & 0xFF);

    plcf_20->plcf[4] = (plcf_20->plcf[4] & 0xF) | (plcf_20->TransmitPower << 4);
    plcf_20->plcf[4] = (plcf_20->plcf[4] & 0xF0) | plcf_20->DFMCS;

    plcf_20->plcf[5] = (uint8_t) (plcf_20->ReceiverIdentity >> 8);
    plcf_20->plcf[6] = (uint8_t) (plcf_20->ReceiverIdentity & 0xFF);

    plcf_20->plcf[7] = (uint8_t) (plcf_20->plcf[7] & 0x3F) | (plcf_20->NumberOfSpatialStreams << 6);
    plcf_20->plcf[7] = (plcf_20->plcf[7] & 0xCF) | (plcf_20->DFRedundancyVersion << 4);
    plcf_20->plcf[7] = (plcf_20->plcf[7] & 0xF7) | (plcf_20->DFNewDataIndication << 3);
    plcf_20->plcf[7] = (plcf_20->plcf[7] & 0xF8) | plcf_20->DFHARQProcessNumber;

    plcf_20->plcf[8] = (uint8_t) (plcf_20->plcf[8] & 0xF) | (plcf_20->FeedbackFormat << 4);
    plcf_20->plcf[8] = (uint8_t) (plcf_20->plcf[8] & 0xF0) | (plcf_20->FeedbackInfo >> 8);

    plcf_20->plcf[9] = (uint8_t) (plcf_20->FeedbackInfo & 0xFF);

    return DECT2020_SUCCESS;
}

int get_plcf_3(plcf_21_t* plcf_21){                                                   //Physical Layer Control Field Type 2 Header Format 001 (6.2.1-2a)

    plcf_21->plcf[0] = (plcf_21->plcf[0] & 0x1F) | (plcf_21->HeaderFormat << 5);
    plcf_21->plcf[0] = (plcf_21->plcf[0] & 0xEF) | (plcf_21->PacketLengthType << 4);
    plcf_21->plcf[0] = (plcf_21->plcf[0] & 0xF0) | plcf_21->PacketLength;

    plcf_21->plcf[1] = plcf_21->ShortNetworkID;

    plcf_21->plcf[2] = (uint8_t) (plcf_21->TransmitterIdentity >> 8);
    plcf_21->plcf[3] = (uint8_t) (plcf_21->TransmitterIdentity & 0xFF);

    plcf_21->plcf[4] = (plcf_21->plcf[4] & 0xF) | (plcf_21->TransmitPower << 4);
    plcf_21->plcf[4] = (plcf_21->plcf[4] & 0xF0) | plcf_21->DFMCS;

    plcf_21->plcf[5] = (uint8_t) (plcf_21->ReceiverIdentity >> 8);
    plcf_21->plcf[6] = (uint8_t) (plcf_21->ReceiverIdentity & 0xFF);

    plcf_21->plcf[7] = (uint8_t) (plcf_21->plcf[7] & 0x3F) | (plcf_21->NumberOfSpatialStreams << 6);
    plcf_21->plcf[7] = (plcf_21->plcf[7] & 0xC0) | plcf_21->Reserved;

    plcf_21->plcf[8] = (uint8_t) (plcf_21->plcf[8] & 0xF) | (plcf_21->FeedbackFormat << 4);
    plcf_21->plcf[8] = (uint8_t) (plcf_21->plcf[8] & 0xF0) | (plcf_21->FeedbackInfo >> 8);

    plcf_21->plcf[9] = (uint8_t) (plcf_21->FeedbackInfo & 0xFF);

    return DECT2020_SUCCESS;
}

int get_plcf_1_rev(plcf_10_t* plcf_10){                           //Metodos de obtencion de datos de la PLCF 6.2.1-1

    plcf_10->HeaderFormat        = plcf_10->plcf[0] >> 5;
    plcf_10->PacketLengthType    = (plcf_10->plcf[0] >> 4) & 1;
    plcf_10->PacketLength        = plcf_10->plcf[0] & 0xF;
    plcf_10->ShortNetworkID      = plcf_10->plcf[1];
    plcf_10->TransmitterIdentity = ((uint16_t) plcf_10->plcf[2]) << 8;
    plcf_10->TransmitterIdentity = (plcf_10->TransmitterIdentity & 0xFF00) | (uint16_t) plcf_10->plcf[3];
    plcf_10->TransmitPower       = plcf_10->plcf[4] >> 4;
    plcf_10->Reserved            = (plcf_10->plcf[4] >> 3) & 1;
    plcf_10->DFMCS               = plcf_10->plcf[4] & 7;

    return DECT2020_SUCCESS;
}

int get_plcf_2_rev(plcf_20_t* plcf_20){                           //Metodos de obtencion de datos de la PLCF 6.2.1-2

    plcf_20->HeaderFormat            = plcf_20->plcf[0] >> 5;
    plcf_20->PacketLengthType        = (plcf_20->plcf[0] >> 4) & 1;
    plcf_20->PacketLength            = plcf_20->plcf[0] & 0xF;
    plcf_20->ShortNetworkID          = plcf_20->plcf[1];
    plcf_20->TransmitterIdentity     = ((uint16_t) plcf_20->plcf[2]) << 8;
    plcf_20->TransmitterIdentity     = (plcf_20->TransmitterIdentity & 0xFF00) | (uint16_t) plcf_20->plcf[3];
    plcf_20->TransmitPower           = plcf_20->plcf[4] >> 4;
    plcf_20->DFMCS                   = plcf_20->plcf[4] & 0xF;
    plcf_20->ReceiverIdentity        = ((uint16_t) plcf_20->plcf[5]) << 8;
    plcf_20->ReceiverIdentity        = (plcf_20->ReceiverIdentity & 0xFF00) | (uint16_t) plcf_20->plcf[6];
    plcf_20->NumberOfSpatialStreams  = plcf_20->plcf[7] >> 6;
    plcf_20->DFRedundancyVersion     = (plcf_20->plcf[7] >> 4) & 3;
    plcf_20->DFNewDataIndication     = (plcf_20->plcf[7] >> 3) & 1;
    plcf_20->DFHARQProcessNumber     = plcf_20->plcf[7] & 7;
    plcf_20->FeedbackFormat          = (plcf_20->plcf[8] >> 4) & 0xF;
    plcf_20->FeedbackInfo            = (uint16_t) (plcf_20->plcf[8] & 0xF) << 8;
    plcf_20->FeedbackInfo            = (plcf_20->FeedbackInfo & 0xFF00) | (uint16_t) plcf_20->plcf[9];

    return DECT2020_SUCCESS;
}

int get_plcf_3_rev(plcf_21_t* plcf_21){                       //Metodos de obtencion de datos de la PLCF 6.2.1-2a

    plcf_21->HeaderFormat            = plcf_21->plcf[0] >> 5;
    plcf_21->PacketLengthType        = (plcf_21->plcf[0] >> 4) & 1;
    plcf_21->PacketLength            = plcf_21->plcf[0] & 0xF;
    plcf_21->ShortNetworkID          = plcf_21->plcf[1];
    plcf_21->TransmitterIdentity     = ((uint16_t) plcf_21->plcf[2]) << 8;
    plcf_21->TransmitterIdentity     = (plcf_21->TransmitterIdentity & 0xFF00) | (uint16_t) plcf_21->plcf[3];
    plcf_21->TransmitPower           = plcf_21->plcf[4] >> 4;
    plcf_21->DFMCS                   = plcf_21->plcf[4] & 0xF;
    plcf_21->ReceiverIdentity        = ((uint16_t) plcf_21->plcf[5]) << 8;
    plcf_21->ReceiverIdentity        = (plcf_21->ReceiverIdentity & 0xFF00) | (uint16_t) plcf_21->plcf[6];
    plcf_21->NumberOfSpatialStreams  = plcf_21->plcf[7] >> 6;
    plcf_21->Reserved                = plcf_21->plcf[7] & 0x3F;
    plcf_21->FeedbackFormat          = (plcf_21->plcf[8] >> 4) & 0xF;
    plcf_21->FeedbackInfo            = (uint16_t) (plcf_21->plcf[8] & 0xF) << 8;
    plcf_21->FeedbackInfo            = (plcf_21->FeedbackInfo & 0xFF00) | (uint16_t) plcf_21->plcf[9];

    return DECT2020_SUCCESS;
}

uint8_t get_transmit_power(int32_t tx_power_dBm){                           //Obtencion de la potencia de tranmision en base al contenido de la cabecera

    uint32_t ret = 15;

    int32_t tx_power_table[16] = {-40, -30, -20, -10, -6, -3, 0, 3, 6, 10, 14, 19, 23, 26, 29, 32};

    // find closest value
    int32_t dist_min = 1000000;
    int32_t dist;
    for(uint32_t i=0; i<16; i++){
        dist = (tx_power_dBm - tx_power_table[i]);
        dist *= dist;

        if(dist <= dist_min){
            dist_min = dist;
            ret = (uint8_t) i;
        }
    }

    return ret;
}

uint8_t get_number_of_spatial_streams(int32_t N_SS){                        
    if(N_SS == 1)
        return 0;
    else if(N_SS == 2)
        return 1;
    else if(N_SS == 4)
        return 2;
    else if(N_SS == 8)
        return 3;

    return 0;
}
```

## src/physical_header_field.h
```c
/*
 * This program is free software: you can redistribute it and/or modify
 * it under the terms of the GNU General Public License as published by
 * the Free Software Foundation, either version 3 of the License, or
 * (at your option) any later version.
 *
 * This program is distributed in the hope that it will be useful,
 * but WITHOUT ANY WARRANTY; without even the implied warranty of
 * MERCHANTABILITY or FITNESS FOR A PARTICULAR PURPOSE.  See the
 * GNU General Public License for more details.
 *
 * You should have received a copy of the GNU General Public License
 * along with this program.  If not, see <http://www.gnu.org/licenses/>.
 *
 * Author: Maxim Penner <maxim.penner@ikt.uni-hannover.de>
 */

#include <stdint.h>

#ifndef DECT2020_PHYSICAL_HEADER_FIELD_H
#define DECT2020_PHYSICAL_HEADER_FIELD_H



// ETSI TS 103 636-4 V1.1.1 (2020-07), 6.2


typedef struct{
    uint8_t HeaderFormat            : 3;
    uint8_t PacketLengthType        : 1;
    uint8_t PacketLength            : 4;
    uint8_t ShortNetworkID          : 8;
    uint16_t TransmitterIdentity    : 16;
    uint8_t TransmitPower           : 4;
    uint8_t Reserved                : 1;
    uint8_t DFMCS                   : 3;

    uint8_t plcf[5];
} plcf_10_t;

typedef struct{
    uint8_t HeaderFormat            : 3;
    uint8_t PacketLengthType        : 1;
    uint8_t PacketLength            : 4;
    uint8_t ShortNetworkID          : 8;
    uint16_t TransmitterIdentity    : 16;
    uint8_t TransmitPower           : 4;
    uint8_t DFMCS                   : 4;
    uint16_t ReceiverIdentity       : 16;
    uint8_t NumberOfSpatialStreams  : 2;
    uint8_t DFRedundancyVersion     : 2;
    uint8_t DFNewDataIndication     : 1;
    uint8_t DFHARQProcessNumber     : 3;
    uint8_t FeedbackFormat          : 4;
    uint16_t FeedbackInfo           : 12;

    uint8_t plcf[10];
} plcf_20_t;

typedef struct{
    uint8_t HeaderFormat            : 3;
    uint8_t PacketLengthType        : 1;
    uint8_t PacketLength            : 4;
    uint8_t ShortNetworkID          : 8;
    uint16_t TransmitterIdentity    : 16;
    uint8_t TransmitPower           : 4;
    uint8_t DFMCS                   : 4;
    uint16_t ReceiverIdentity       : 16;
    uint8_t NumberOfSpatialStreams  : 2;
    uint8_t Reserved                : 6;
    uint8_t FeedbackFormat          : 4;
    uint16_t FeedbackInfo           : 12;

    uint8_t plcf[10];
} plcf_21_t;

int get_plcf_1(plcf_10_t* plcf_10);
int get_plcf_2(plcf_20_t* plcf_20);
int get_plcf_3(plcf_21_t* plcf_21);

int get_plcf_1_rev(plcf_10_t* plcf_10);
int get_plcf_2_rev(plcf_20_t* plcf_20);
int get_plcf_3_rev(plcf_21_t* plcf_21);

uint8_t get_transmit_power(int32_t tx_power_dBm);

uint8_t get_number_of_spatial_streams(int32_t N_SS);



#endif
```

## src/tx_rx.h
```c
#include <strings.h>

#ifndef TX_RX_H
#define TX_RX_H


int modem_rx(void);
int modem_tx(uint8_t* data, size_t length, uint8_t* header, size_t header_length);
void init(void);
void op_complete(void);
void rssi(void);
void rx_stop(void);
void pcc(void);
void pcc_crc_err(void);
void pdc(void);
void pdc_crc_err(void);
void link_config(void);
void time_get(void);
void capability_get(void);
void deinit(void);


#endif
```
